/* USER CODE BEGIN Header */
/**
  ******************************************************************************
  * @file           : main.c
  * @brief          : Flight controller firmware
  * @author					: Nestor Stavrakoudis
  ******************************************************************************
  * Firmware for the autonomous drone's flight controller board.
  * Blocks outside USER CODE delimiters are automatically
  * generated by STM32CubeMX.
  ******************************************************************************
**/


/* USER CODE END Header */
/* Includes ------------------------------------------------------------------*/
#include "main.h"
#include "adc.h"
#include "dma.h"
#include "i2c.h"
#include "spi.h"
#include "tim.h"
#include "usart.h"
#include "gpio.h"

#include <math.h>
/* Private includes ----------------------------------------------------------*/
/* USER CODE BEGIN Includes */
#include "lsm6dsv32x.h" // IMU header
#include "bmp388.h"			// Barometer header
#include "sam_m10q.h"		// GPS header
#include "ep1.h"				// Radio receiver header
/* USER CODE END Includes */

/* Private typedef -----------------------------------------------------------*/
/* USER CODE BEGIN PTD */
typedef enum {
	AUTONOMOUS,
	MANUAL_ONLY,
	FATAL,
	UNDETERMINED
} Sensor_Status;

typedef struct {
	float roll;
	float pitch;
	float yaw;
} Attitude;

typedef struct {
	int16_t FL;	//Front left
	int16_t FR;	//Front right
	int16_t BL;	//Back left
	int16_t BR;	//Back right
} Motor_PWM_Packet;
/* USER CODE END PTD */

/* Private define ------------------------------------------------------------*/
/* USER CODE BEGIN PD */
#define RAD_TO_DEG 57.2957795131f		// We avoid 180/M_PI to save CPU work

/* PID values follow, these are just placeholders and must be experimentally tested*/
#define PITCH_P	1.5f		// Proportional term of the pitch PID loop.
#define PITCH_I	0.001f		// Integral term of the pitch PID loop.
#define PITCH_D	200.0f		// Derivative term of the pitch PID loop.

#define ROLL_P	1.5f		// Proportional term of the roll PID loop.
#define ROLL_I	0.001f		// Integral term of the roll PID loop.
#define ROLL_D	200.0f		// Derivative term of the roll PID loop.

#define YAW_P	0.7f				// Proportianal term of the yaw PID loop.
#define YAW_I	0.005f			// Integral term of the yaw PID loop.
// Yaw does not usually have a derivative term

#define ROLL_PITCH_AUTHORITY 2.5f		// Yaw output is divided by this to keep roll/pitch the most important factors


#define PID_I_LIMIT		10000.0f		// PID integral term clamp
#define PID_OUT_LIMIT	400.0f		// Maximum output
#define THROTTLE_I_THRESHOLD	0.1f	// Below a certain throttle (for example on ground) we shouldn't use
																	// the integrator term because it keeps rising

#define MOTOR_TIMER		&htim1
#define MOTOR_FL				TIM_CHANNEL_1
#define MOTOR_FR				TIM_CHANNEL_2
#define MOTOR_BL				TIM_CHANNEL_3
#define MOTOR_BR				TIM_CHANNEL_4
/* USER CODE END PD */

/* Private macro -------------------------------------------------------------*/
/* USER CODE BEGIN PM */

#define LED1_R_On()	(HAL_GPIO_WritePin(LED1_R_GPIO_Port,LED1_R_Pin,GPIO_PIN_RESET))
#define LED1_G_On()	(HAL_GPIO_WritePin(LED1_G_GPIO_Port,LED1_G_Pin,GPIO_PIN_RESET))
#define LED2_R_On()	(HAL_GPIO_WritePin(LED2_R_GPIO_Port,LED2_R_Pin,GPIO_PIN_RESET))
#define LED2_G_On()	(HAL_GPIO_WritePin(LED2_G_GPIO_Port,LED2_G_Pin,GPIO_PIN_RESET))

#define LED1_R_Off()	(HAL_GPIO_WritePin(LED1_R_GPIO_Port,LED1_R_Pin,GPIO_PIN_SET))
#define LED1_G_Off()	(HAL_GPIO_WritePin(LED1_G_GPIO_Port,LED1_G_Pin,GPIO_PIN_SET))
#define LED2_R_Off()	(HAL_GPIO_WritePin(LED2_R_GPIO_Port,LED2_R_Pin,GPIO_PIN_SET))
#define LED2_G_Off()	(HAL_GPIO_WritePin(LED2_G_GPIO_Port,LED2_G_Pin,GPIO_PIN_SET))

#define LED1_R_Toggle()	(HAL_GPIO_TogglePin(LED1_R_GPIO_Port,LED1_R_Pin))
#define LED1_G_Toggle()	(HAL_GPIO_TogglePin(LED1_G_GPIO_Port,LED1_G_Pin))
#define LED2_R_Toggle()	(HAL_GPIO_TogglePin(LED2_R_GPIO_Port,LED2_R_Pin))
#define LED2_G_Toggle()	(HAL_GPIO_TogglePin(LED2_G_GPIO_Port,LED2_G_Pin))
/* USER CODE END PM */

/* Private variables ---------------------------------------------------------*/

/* USER CODE BEGIN PV */
volatile Sensor_Status sensor_status = UNDETERMINED;
volatile Attitude attitude;				// Attitude
volatile Attitude attitude_accel;	// Attitude (accelerometer only)
volatile Attitude error;
volatile Attitude error_old;


volatile Motor_PWM_Packet Motor_PWM;

volatile float roll_error_i;		// integral accumulator of roll pid loop
volatile float pitch_error_i;		// integral accumulator of pitch pid loop

volatile float yaw_rate_error;	// integral accumulator of yaw rate
volatile float yaw_error_i;			// integral accumulator of yaw pid loop


/* USER CODE END PV */

/* Private function prototypes -----------------------------------------------*/
void SystemClock_Config(void);
/* USER CODE BEGIN PFP */

/* USER CODE END PFP */

/* Private user code ---------------------------------------------------------*/
/* USER CODE BEGIN 0 */
void IMU_TxRxCpltCallback();
void ALT_TxRxCpltCallback();

void LED_Test_Sequence();

void HAL_SPI_TxRxCpltCallback(SPI_HandleTypeDef *hspi){
	if (hspi == IMU_INTERFACE){ // These events refer to the IMU SPI DMA.
		IMU_TxRxCpltCallback();
	}
	if (hspi == ALT_INTERFACE){
		ALT_TxRxCpltCallback();
	}
}

void IMU_TxRxCpltCallback(){
	HAL_GPIO_WritePin(IMU_CS_GPIO_Port, IMU_CS_Pin, GPIO_PIN_SET);
	switch(IMU_Current_DMA_Transaction) {
		case IMU_WRITE_REG:
			break; // No additional processing is required on register write.
		case IMU_SINGLE_REG:
			break; // Not used yet (all single register reads use blocking mode)
		case IMU_PACKET: // Parse IMU Packet
			IMU_Raw.A_X = (IMU_SPI_IMUPacket_RX[IMU_OUTX_H_A-0x21] << 8) + IMU_SPI_IMUPacket_RX[IMU_OUTX_L_A-0x21];
			IMU_Raw.A_Y = (IMU_SPI_IMUPacket_RX[IMU_OUTY_H_A-0x21] << 8) + IMU_SPI_IMUPacket_RX[IMU_OUTY_L_A-0x21];
			IMU_Raw.A_Z = (IMU_SPI_IMUPacket_RX[IMU_OUTZ_H_A-0x21] << 8) + IMU_SPI_IMUPacket_RX[IMU_OUTZ_L_A-0x21];

			IMU_Raw.G_X = (IMU_SPI_IMUPacket_RX[IMU_OUTX_H_G-0x21] << 8) + IMU_SPI_IMUPacket_RX[IMU_OUTX_L_G-0x21];
			IMU_Raw.G_Y = (IMU_SPI_IMUPacket_RX[IMU_OUTY_H_G-0x21] << 8) + IMU_SPI_IMUPacket_RX[IMU_OUTY_L_G-0x21];
			IMU_Raw.G_Z = (IMU_SPI_IMUPacket_RX[IMU_OUTZ_H_G-0x21] << 8) + IMU_SPI_IMUPacket_RX[IMU_OUTZ_L_G-0x21];

			IMU_Data.A_X = IMU_Raw.A_X * 0.976f - IMU_Bias.A_X;	// Scaling factor comes from "Linear
			IMU_Data.A_Y = IMU_Raw.A_Y * 0.976f - IMU_Bias.A_Y;	// acceleration sensitivity", p.12 on datasheet
			IMU_Data.A_Z = IMU_Raw.A_Z * 0.976f - IMU_Bias.A_Z;

			IMU_Data.G_X = IMU_Raw.G_X * 0.07f - IMU_Bias.G_X;	// Scaling factor comes from "Angular
			IMU_Data.G_Y = IMU_Raw.G_Y * 0.07f - IMU_Bias.G_Y;	// rate sensitivity", p.12 on datasheet
			IMU_Data.G_Z = IMU_Raw.G_Z * 0.07f - IMU_Bias.G_Z;

			IMU_Angles.G_X += IMU_Data.G_X / 1920.0f;	// Integrate rates
			IMU_Angles.G_Y += IMU_Data.G_Y / 1920.0f;
			IMU_Angles.G_Z += IMU_Data.G_Z / 1920.0f;

			error_old.roll = Radio_Scaled.roll - attitude.roll;
			error_old.pitch = Radio_Scaled.pitch - attitude.pitch;

			attitude_accel.roll = atan2f(IMU_Data.A_Y, IMU_Data.A_Z);
			attitude_accel.roll *= RAD_TO_DEG;
			attitude.roll += IMU_Data.G_X*0.000520833f;//1/1920
			attitude.roll = IMU_FILTER_COEFFICIENT * attitude.roll + (1-IMU_FILTER_COEFFICIENT) *
					attitude_accel.roll;		// Complementary filter for roll

			attitude_accel.pitch = atan2f(-IMU_Data.A_X, sqrtf(IMU_Data.A_Y*IMU_Data.A_Y + IMU_Data.A_Z*IMU_Data.A_Z));
			attitude_accel.pitch *= RAD_TO_DEG;
			attitude.pitch += IMU_Data.G_Y*0.000520833f;//1/1920
			attitude.pitch = IMU_FILTER_COEFFICIENT * attitude.pitch + (1-IMU_FILTER_COEFFICIENT) *
								attitude_accel.pitch;	// Complementary filter for pitch

			attitude.yaw += IMU_Data.G_Z*0.000520833f;	// Yaw has no complementary filter as gravity reference does not change by rotating about the yaw axis

			if(IMU_Calibrated){
				roll_error_i += Radio_Scaled.roll-attitude.roll;
				roll_error_i *= ((!Radio_Scaled.armed ||
						Radio_Scaled.throttle < THROTTLE_I_THRESHOLD)?0:1);
				if(roll_error_i>PID_I_LIMIT) roll_error_i=PID_I_LIMIT;
				if(roll_error_i<-PID_I_LIMIT) roll_error_i=-PID_I_LIMIT;

				pitch_error_i += Radio_Scaled.pitch-attitude.pitch;
				pitch_error_i *= ((!Radio_Scaled.armed ||
						Radio_Scaled.throttle < THROTTLE_I_THRESHOLD)?0:1);
				if(pitch_error_i>PID_I_LIMIT) pitch_error_i=PID_I_LIMIT;
				if(pitch_error_i<-PID_I_LIMIT) pitch_error_i=-PID_I_LIMIT;

				yaw_error_i += Radio_Scaled.yaw-IMU_Data.G_Z;
				yaw_error_i *= ((!Radio_Scaled.armed ||
						Radio_Scaled.throttle < THROTTLE_I_THRESHOLD)?0:1);
				if(yaw_error_i>PID_I_LIMIT) yaw_error_i=PID_I_LIMIT;
				if(yaw_error_i<-PID_I_LIMIT) yaw_error_i=-PID_I_LIMIT;

				error.roll = ROLL_P * (Radio_Scaled.roll - attitude.roll) +
						ROLL_I * roll_error_i +
						ROLL_D * ((Radio_Scaled.roll - attitude.roll) - error_old.roll);	// PID loop for roll
				if(error.roll>PID_OUT_LIMIT) error.roll = PID_OUT_LIMIT;
				if(error.roll<-PID_OUT_LIMIT) error.roll = -PID_OUT_LIMIT;

				error.pitch = PITCH_P * (Radio_Scaled.pitch - attitude.pitch) +
						PITCH_I * pitch_error_i +
						PITCH_D * ((Radio_Scaled.pitch - attitude.pitch) - error_old.pitch);	// PID loop for pitch
				if(error.pitch>PID_OUT_LIMIT) error.pitch = PID_OUT_LIMIT;
				if(error.pitch<-PID_OUT_LIMIT) error.pitch = -PID_OUT_LIMIT;

				error.yaw = YAW_P * (Radio_Scaled.yaw - IMU_Data.G_Z) +
						YAW_I * yaw_error_i;	// PID loop for yaw
				if(error.yaw>PID_OUT_LIMIT) error.yaw = PID_OUT_LIMIT;
				if(error.yaw<-PID_OUT_LIMIT) error.yaw = -PID_OUT_LIMIT;
				error.yaw /= ROLL_PITCH_AUTHORITY;	// Keep pitch/roll the most impactful steering factors
			}

			/* Motor mixer */
			Motor_PWM.FL = Radio_Scaled.throttle * 1000 + error.roll - error.pitch - error.yaw;	// PID loop is maxing out on 400 (160 for yaw) so we multiply throttle by 1000 (arbitrarily)
			Motor_PWM.FR = Radio_Scaled.throttle * 1000 - error.roll - error.pitch + error.yaw;
			Motor_PWM.BL = Radio_Scaled.throttle * 1000 + error.roll + error.pitch + error.yaw;
			Motor_PWM.BR = Radio_Scaled.throttle * 1000 - error.roll + error.pitch - error.yaw;

			if(Motor_PWM.FL > 1000) Motor_PWM.FL = 1000;
			if(Motor_PWM.FR > 1000) Motor_PWM.FR = 1000;
			if(Motor_PWM.BL > 1000) Motor_PWM.BL = 1000;
			if(Motor_PWM.BR > 1000) Motor_PWM.BR = 1000;

			if(Motor_PWM.FL < 0) Motor_PWM.FL = 0;
			if(Motor_PWM.FR < 0) Motor_PWM.FR = 0;
			if(Motor_PWM.BL < 0) Motor_PWM.BL = 0;
			if(Motor_PWM.BR < 0) Motor_PWM.BR = 0;

			if(!Radio_Scaled.armed || Radio_Scaled.kill || !IMU_Calibrated) { // Unless properly calibrated and armed stop the motors
				Motor_PWM.FL = 0;
				Motor_PWM.FR = 0;
				Motor_PWM.BL = 0;
				Motor_PWM.BR = 0;
			}

			Motor_PWM.FL+=1000; // Output should be period in us, 1000-2000
			Motor_PWM.FR+=1000;
			Motor_PWM.BL+=1000;
			Motor_PWM.BR+=1000;

			__HAL_TIM_SET_COMPARE(MOTOR_TIMER,MOTOR_FL,Motor_PWM.FL);  // Write the CCR to set the PWM duty cycle
			__HAL_TIM_SET_COMPARE(MOTOR_TIMER,MOTOR_FR,Motor_PWM.FR);
			__HAL_TIM_SET_COMPARE(MOTOR_TIMER,MOTOR_BL,Motor_PWM.BL);
			__HAL_TIM_SET_COMPARE(MOTOR_TIMER,MOTOR_BR,Motor_PWM.BR);

			break;
	}
}

void ALT_TxRxCpltCallback(){
	HAL_GPIO_WritePin(ALT_CS_GPIO_Port, ALT_CS_Pin, GPIO_PIN_SET);
	switch(ALT_Current_DMA_Transaction) {
		case ALT_WRITE_REG:
			break; // No additional processing is required on register write.
		case ALT_SINGLE_REG:
			break; // Not used yet (all single register reads use blocking mode)
		case ALT_PACKET: // Parse barometer Packet
			ALT_Raw.P = (ALT_SPI_ALTPacket_RX[ALT_OUT_PRES_H-0x02] << 16)
								+ (ALT_SPI_ALTPacket_RX[ALT_OUT_PRES_M-0x02] << 8)
								+ ALT_SPI_ALTPacket_RX[ALT_OUT_PRES_L-0x02];

			ALT_Raw.T = (ALT_SPI_ALTPacket_RX[ALT_OUT_TEMP_H-0x02] << 16)
								+ (ALT_SPI_ALTPacket_RX[ALT_OUT_TEMP_M-0x02] << 8)
								+ ALT_SPI_ALTPacket_RX[ALT_OUT_TEMP_L-0x02];

			ALT_Compensate();
			break;
	}
}


void LED_Test_Sequence(){
  HAL_GPIO_TogglePin(LED1_R_GPIO_Port, LED1_R_Pin);  // ON (pull low)
  HAL_Delay(200);
  HAL_GPIO_TogglePin(LED1_G_GPIO_Port, LED1_G_Pin);
  HAL_Delay(200);
  HAL_GPIO_TogglePin(LED2_R_GPIO_Port, LED2_R_Pin);
  HAL_Delay(200);
  HAL_GPIO_TogglePin(LED2_G_GPIO_Port, LED2_G_Pin);
  HAL_Delay(200);

  HAL_GPIO_TogglePin(LED1_R_GPIO_Port, LED1_R_Pin);
  HAL_Delay(200);
  HAL_GPIO_TogglePin(LED1_G_GPIO_Port, LED1_G_Pin);// OFF (release high)
  HAL_Delay(200);
  HAL_GPIO_TogglePin(LED2_R_GPIO_Port, LED2_R_Pin);
  HAL_Delay(200);
  HAL_GPIO_TogglePin(LED2_G_GPIO_Port, LED2_G_Pin);
  HAL_Delay(200);

  HAL_GPIO_TogglePin(LED1_R_GPIO_Port, LED1_R_Pin);
  HAL_GPIO_TogglePin(LED2_R_GPIO_Port, LED2_R_Pin);

}

void HAL_TIM_PeriodElapsedCallback(TIM_HandleTypeDef *htim){
	/* Used for blinking LEDs based on TIM3 */
	if(htim->Instance == TIM3){
		if(sensor_status == FATAL){
			LED1_G_Off();
			LED2_G_Off();
			LED1_R_Toggle();
			LED2_R_Toggle();
		} else if(sensor_status == MANUAL_ONLY) {
			LED1_G_On();
			if(GPS_Status == GPS_BOOTING)
				LED2_G_Toggle();	// GPS active but no fix
			else if(GPS_Status == GPS_OPERATIONAL)
				LED2_G_On();			// GPS position data coming in
			else
				LED2_G_Off();			// GPS inactive/dead
			LED1_R_Off();				// IMU operational
			LED2_R_Toggle();	// Barometer inactive/dead
		}
	}
}

void HAL_GPIO_EXTI_Callback(uint16_t EXTI_Pin){
	/* External interrupt callback */
	if(EXTI_Pin == ALT_INT_Pin){
		ALT_Read();
	}	else if(EXTI_Pin == IMU_INT1_Pin){
		IMU_Read();
	}
}
/* USER CODE END 0 */

/**
  * @brief  The application entry point.
  * @retval int
  */
int main(void)
{

  /* USER CODE BEGIN 1 */
	Radio_Scaled.pitch = 0;	// Initialize radio values to ensure no undefined behavior on startup
	Radio_Scaled.roll = 0;
	Radio_Scaled.throttle = 0;
	Radio_Scaled.yaw = 0;
	Radio_Scaled.armed = 0;
  /* USER CODE END 1 */

  /* MCU Configuration--------------------------------------------------------*/

  /* Reset of all peripherals, Initializes the Flash interface and the Systick. */
  HAL_Init();

  /* USER CODE BEGIN Init */

  /* USER CODE END Init */

  /* Configure the system clock */
  SystemClock_Config();

  /* USER CODE BEGIN SysInit */

  /* USER CODE END SysInit */

  /* Initialize all configured peripherals */
  MX_GPIO_Init();
  MX_DMA_Init();
  MX_ADC1_Init();
  MX_I2C1_Init();
  MX_SPI1_Init();
  MX_SPI3_Init();
  MX_TIM1_Init();
  MX_TIM2_Init();
  MX_USART2_UART_Init();
  MX_USART3_UART_Init();
  MX_TIM3_Init();
  /* USER CODE BEGIN 2 */
  HAL_TIM_Base_Start_IT(&htim3);	// TIM3 has a period of 200ms and is used to blink LEDs for status.

  HAL_TIM_Base_Start(MOTOR_TIMER);
  HAL_TIM_PWM_Start(MOTOR_TIMER, MOTOR_FL);
  HAL_TIM_PWM_Start(MOTOR_TIMER, MOTOR_FR);
  HAL_TIM_PWM_Start(MOTOR_TIMER, MOTOR_BL);
  HAL_TIM_PWM_Start(MOTOR_TIMER, MOTOR_BR);


  __HAL_SPI_ENABLE(&hspi1);
  // LED testing sequence. Additionally, it gives time for everything to power up.
  LED_Test_Sequence();

  IMU_Test();		// Test the IMU
  if(IMU_Status == IMU_FAULTY){
  	sensor_status = FATAL;
  } else {
  	sensor_status = MANUAL_ONLY;
  	IMU_Init();
  }

  GPS_Init();
  Radio_Init();

  /* USER CODE END 2 */

  /* Infinite loop */
  /* USER CODE BEGIN WHILE */
  while (1)
  {
    /* USER CODE END WHILE */

    /* USER CODE BEGIN 3 */
  }
  /* USER CODE END 3 */
}

/**
  * @brief System Clock Configuration
  * @retval None
  */
void SystemClock_Config(void)
{
  RCC_OscInitTypeDef RCC_OscInitStruct = {0};
  RCC_ClkInitTypeDef RCC_ClkInitStruct = {0};

  /** Configure the main internal regulator output voltage
  */
  __HAL_RCC_PWR_CLK_ENABLE();
  __HAL_PWR_VOLTAGESCALING_CONFIG(PWR_REGULATOR_VOLTAGE_SCALE1);

  /** Initializes the RCC Oscillators according to the specified parameters
  * in the RCC_OscInitTypeDef structure.
  */
  RCC_OscInitStruct.OscillatorType = RCC_OSCILLATORTYPE_HSE;
  RCC_OscInitStruct.HSEState = RCC_HSE_ON;
  RCC_OscInitStruct.PLL.PLLState = RCC_PLL_ON;
  RCC_OscInitStruct.PLL.PLLSource = RCC_PLLSOURCE_HSE;
  RCC_OscInitStruct.PLL.PLLM = 12;
  RCC_OscInitStruct.PLL.PLLN = 168;
  RCC_OscInitStruct.PLL.PLLP = RCC_PLLP_DIV2;
  RCC_OscInitStruct.PLL.PLLQ = 4;
  if (HAL_RCC_OscConfig(&RCC_OscInitStruct) != HAL_OK)
  {
    Error_Handler();
  }

  /** Initializes the CPU, AHB and APB buses clocks
  */
  RCC_ClkInitStruct.ClockType = RCC_CLOCKTYPE_HCLK|RCC_CLOCKTYPE_SYSCLK
                              |RCC_CLOCKTYPE_PCLK1|RCC_CLOCKTYPE_PCLK2;
  RCC_ClkInitStruct.SYSCLKSource = RCC_SYSCLKSOURCE_PLLCLK;
  RCC_ClkInitStruct.AHBCLKDivider = RCC_SYSCLK_DIV1;
  RCC_ClkInitStruct.APB1CLKDivider = RCC_HCLK_DIV4;
  RCC_ClkInitStruct.APB2CLKDivider = RCC_HCLK_DIV2;

  if (HAL_RCC_ClockConfig(&RCC_ClkInitStruct, FLASH_LATENCY_5) != HAL_OK)
  {
    Error_Handler();
  }
}

/* USER CODE BEGIN 4 */

/* USER CODE END 4 */

/**
  * @brief  This function is executed in case of error occurrence.
  * @retval None
  */
void Error_Handler(void)
{
  /* USER CODE BEGIN Error_Handler_Debug */
  /* User can add his own implementation to report the HAL error return state */
  __disable_irq();
  while (1)
  {
  }
  /* USER CODE END Error_Handler_Debug */
}
#ifdef USE_FULL_ASSERT
/**
  * @brief  Reports the name of the source file and the source line number
  *         where the assert_param error has occurred.
  * @param  file: pointer to the source file name
  * @param  line: assert_param error line source number
  * @retval None
  */
void assert_failed(uint8_t *file, uint32_t line)
{
  /* USER CODE BEGIN 6 */
  /* User can add his own implementation to report the file name and line number,
     ex: printf("Wrong parameters value: file %s on line %d\r\n", file, line) */
  /* USER CODE END 6 */
}
#endif /* USE_FULL_ASSERT */
